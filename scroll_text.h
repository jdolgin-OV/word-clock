#ifndef _scroll_text_H
#define _scroll_text_H

#define CHAR_WIDTH 6   //How many columns wide each letter is 
#define CHAR_HEIGHT 12 //letter height 
#define DIFF_LOWERCASE 2  //difference in width between upper and lowercase letters
uint8_t OFFSET = 0;

#define NUM_COLS      48   //Number of Columns

bool toDisplay[NUM_COLS][CHAR_HEIGHT] = {0};  //Array that is being displayed
bool backBuffer[NUM_COLS][CHAR_HEIGHT] = {0}; //Array that shifts into what is being displayed

/*
  Font array, each letter is contained within a 6x12 box, where a 1 represents a light shown
  for example lowercase o is
  000000
  000000
  000000
  000000
  000000
  000000
  000000
  111100
  100100
  100100
  111100
  000000
*/
bool font[95][CHAR_WIDTH][CHAR_HEIGHT] PROGMEM =  {{{0, 0, 0, 0, 0, 0, 0, 0, 0, 0, 0, 0}, {0, 0, 0, 0, 0, 0, 0, 0, 0, 0, 0, 0}, {0, 0, 0, 0, 0, 0, 0, 0, 0, 0, 0, 0}, {0, 0, 0, 0, 0, 0, 0, 0, 0, 0, 0, 0}, {0, 0, 0, 0, 0, 0, 0, 0, 0, 0, 0, 0}, {0, 0, 0, 0, 0, 0, 0, 0, 0, 0, 0, 0}}, //space
  {{0, 0, 0, 0, 0, 0, 0, 0, 0, 0, 0, 0}, {0, 0, 0, 0, 0, 0, 0, 0, 0, 0, 0, 0}, {0, 1, 1, 1, 1, 1, 1, 1, 1, 0, 1, 1}, {0, 1, 1, 1, 1, 1, 1, 1, 1, 0, 1, 1}, {0, 0, 0, 0, 0, 0, 0, 0, 0, 0, 0, 0}, {0, 0, 0, 0, 0, 0, 0, 0, 0, 0, 0, 0}}, //!
  {{0, 0, 0, 0, 0, 0, 0, 0, 0, 0, 0, 0}, {0, 1, 1, 1, 0, 0, 0, 0, 0, 0, 0, 0}, {0, 1, 1, 0, 1, 0, 0, 0, 0, 0, 0, 0}, {0, 0, 0, 0, 0, 0, 0, 0, 0, 0, 0, 0}, {0, 1, 1, 1, 0, 0, 0, 0, 0, 0, 0, 0}, {0, 1, 1, 0, 1, 0, 0, 0, 0, 0, 0, 0}}, //"
  {{0, 0, 0, 0, 1, 0, 0, 1, 0, 0, 0, 0}, {0, 0, 1, 1, 1, 1, 1, 1, 1, 1, 0, 0}, {0, 0, 0, 0, 1, 0, 0, 1, 0, 0, 0, 0}, {0, 0, 0, 0, 1, 0, 0, 1, 0, 0, 0, 0}, {0, 0, 1, 1, 1, 1, 1, 1, 1, 1, 0, 0}, {0, 0, 0, 0, 1, 0, 0, 1, 0, 0, 0, 0}}, //#
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  {{0, 0, 0, 0, 0, 0, 1, 0, 0, 0, 0, 0}, {0, 0, 0, 0, 0, 1, 0, 0, 0, 0, 0, 0}, {0, 0, 0, 0, 0, 1, 0, 0, 0, 0, 0, 0}, {0, 0, 0, 0, 0, 0, 1, 0, 0, 0, 0, 0}, {0, 0, 0, 0, 0, 0, 1, 0, 0, 0, 0, 0}, {0, 0, 0, 0, 0, 1, 0, 0, 0, 0, 0, 0}} //~
};

//array of colors that show the omers logo array[x][y] is the color shown in box [x][y] starting in top left corner
uint32_t OMERS_LOGO[mh][mw / LEDS_PER_COL] PROGMEM = {{0xffffff, 0xffffff, 0xffffff, 0xffffff, 0x213fff,  0x213fff,  0x213fff, 0xffffff, 0xffffff, 0xffffff, 0xffffff, 0xffffff},
  {0xffffff, 0xffffff, 0xffffff, 0xffffff, 0xffffff, 0xffffff, 0x213fff, 0x213fff, 0x213fff, 0xffffff, 0xffffff, 0xffffff},
  {0xffffff, 0xffffff, 0xe37419, 0xe37419, 0xe37419, 0xffffff, 0xffffff, 0x213fff, 0x213fff, 0x213fff, 0xffffff, 0xffffff},
  {0xffffff, 0xe37419, 0xe37419, 0xe37419, 0xffffff, 0xffffff, 0xffffff, 0xffffff, 0x213fff, 0x213fff, 0x213fff, 0xffffff},
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  {0xffffff, 0xffffff, 0xffffff, 0xe37419, 0xe37419, 0xe37419, 0xffffff, 0xffffff, 0xffffff, 0xffffff, 0xffffff, 0xffffff}
};

//load buffer character
void loadBuffer(uint8_t value) {
  //load a space, adjust if less LEDS PER COL are used
  for (uint8_t j = 0; j < CHAR_HEIGHT; j++)
  {
    backBuffer[0][j] = 0;
    backBuffer[1][j] = 0;
    backBuffer[2][j] = 0;
    backBuffer[3][j] = 0;
  }

  //load character
  for (uint8_t i = 0; i < (CHAR_WIDTH - OFFSET) * LEDS_PER_COL; i++)
  {
    for (uint8_t j = 0; j < CHAR_HEIGHT; j++)
    {
      backBuffer[i + LEDS_PER_COL][j] = font[value][(i / LEDS_PER_COL)][j];
    }
  }
}

void load_leds()
{
  //take toDisplay and draw the pixels
  for (uint8_t x = 0; x < NUM_COLS; x++)
  {
    for (uint8_t y = 0; y < CHAR_HEIGHT; y ++)
    {
      if (toDisplay[x][y])
      {
        matrix->drawPixel(x, y, matrix->Color(red, green, blue));
      }
      else
      {
        matrix->drawPixel(x, y, matrix->Color(0, 0, 0));
      }
    }
  }
}

void scroll()
{
  //shift out an entire letter, OFFSET scrolls less so that there isnt a bigger space between lowercase letters
  for (uint8_t shift = 0; shift < (CHAR_WIDTH - OFFSET) * LEDS_PER_COL + LEDS_PER_COL; shift++)
  {
    //move everything over one col
    for (uint8_t i = 1; i < NUM_COLS; i++)
    {
      for (uint8_t j = 0; j < CHAR_HEIGHT; j++)
      {
        toDisplay[i - 1][j] = toDisplay[i][j];
        backBuffer[i - 1][j] = backBuffer[i][j];
      }
    }
    //move one col from back buffer
    for (uint8_t j = 0; j < CHAR_HEIGHT; j++)
    {
      toDisplay[NUM_COLS - 1][j] = backBuffer[0][j];
      backBuffer[NUM_COLS - 1][j] = 0;
    }

    load_leds();
    //every 4 scrolls show it
    if ((shift % 4) - 2 == 0)
    {
      matrix->show();
      delay(scroll_speed);
    }
  }
}

void scroll_text(String message)
{
  //add a space buffer to the back of the message
  message = message + "  ";

  matrix->setBrightness(brightness);
  uint8_t value = message.charAt(pointer);
  value = value - 32;
  //adjust ascii value to array pointer
  if (value == 0 || (value >= 65 && value <= 75) || (value >= 78 && value <= 83) || (value >= 85 && value <= 86) || (value >= 88 && value <= 90))
  {
    //if lowercase or space change offset
    OFFSET = DIFF_LOWERCASE;
  }
  //if lowercase m or w, the length is 1 longer
  else if (value == 77 || value == 87)
  {
    OFFSET = DIFF_LOWERCASE - 1;
  }
  else if (value == 76 || value == 84)
  {
    //if lowercase l or t, the length is 1 shorter
    OFFSET = DIFF_LOWERCASE + 1;
  }
  else
  {
    OFFSET = 0;
  }
  loadBuffer(value);
  scroll();
  //move pointer
  pointer = (pointer + 1) % message.length(); //Increment pointer, pointer =< message length
}

void show_image(uint32_t img[mh][mw / LEDS_PER_COL])
{
  for (uint8_t i = 0; i < mh; i++)
  {
    for (uint8_t j = 0; j < mw; j++)
    {
      matrix->drawPixel(j, i, CRGB(img[i][j / LEDS_PER_COL]));
    }
  }
  matrix->show();
}



#endif
